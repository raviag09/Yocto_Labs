## meta-yocto-tutorial/conf/layer.conf
```bitbake
# We have a conf and classes directory, add to BBPATH
BBPATH .= ":${LAYERDIR}"

# We have recipes-* directories, add to BBFILES
BBFILES += "${LAYERDIR}/recipes-*/*/*.bb \
            ${LAYERDIR}/recipes-*/*/*.bbappend"

BBFILE_COLLECTIONS += "meta-yocto-tutorial"
BBFILE_PATTERN_meta-yocto-tutorial = "^${LAYERDIR}/"
BBFILE_PRIORITY_meta-yocto-tutorial = "6"

LAYERDEPENDS_meta-yocto-tutorial = "core"
LAYERSERIES_COMPAT_meta-yocto-tutorial = "thud"
```
